## Documentation/devicetree/bindings/phy/airoha,pcie-phy.yaml
```yaml
# SPDX-License-Identifier: (GPL-2.0 OR BSD-2-Clause)
%YAML 1.2
---
$id: http://devicetree.org/schemas/phy/airoha,pcie-phy.yaml#
$schema: http://devicetree.org/meta-schemas/core.yaml#

title: Airoha PCIe PHY

maintainers:
  - Lorenzo Bianconi <lorenzo@kernel.org>

description: |
  The PCIe PHY supports physical layer functionality for PCIe Gen2/Gen3 port.

properties:
  compatible:
    const: airoha,en7581-pcie-phy

  reg:
    maxItems: 3

  reg-names:
    items:
      - const: ana_2l
      - const: pma0
      - const: pma1

  "#phy-cells":
    const: 0

required:
  - compatible
  - reg
  - reg-names
  - "#phy-cells"

additionalProperties: false

examples:
  - |
    phy@11e80000 {
        compatible = "airoha,en7581-pcie-phy";
        #phy-cells = <0>;
        reg = <0x0 0x1fa5a000 0x0 0xfff>,
              <0x0 0x1fa5b000 0x0 0xfff>,
              <0x0 0x1fa5c000 0x0 0xfff>;
        reg-names = "ana_2l", "pma0", "pma1";
    };
```

## Documentation/devicetree/bindings/spi/airoha,spi-airoha-snfi.yaml
```yaml
# SPDX-License-Identifier: (GPL-2.0-only OR BSD-2-Clause)
%YAML 1.2
---
$id: http://devicetree.org/schemas/spi/mediatek,spi-airoha-snfi.yaml#
$schema: http://devicetree.org/meta-schemas/core.yaml#

title: SPI-NAND flash controller for Airoha ARM SoCs

maintainers:
  - Lorenzo Bianconi <lorenzo@kernel.org>

properties:
  compatible:
    const: airoha,en7581-snand

  reg:
    maxItems: 2

  interrupts:
    maxItems: 1

required:
  - compatible
  - reg
  - interrupts

additionalProperties: false

examples:
  - |
    #include <dt-bindings/interrupt-controller/irq.h>
    #include <dt-bindings/interrupt-controller/arm-gic.h>
    soc {
      #address-cells = <2>;
      #size-cells = <2>;
      snfi: spi@1fa10000 {
        compatible = "airoha,en7581-snand";
        reg = <0x0 0x1fa10000 0x0 0x140>,
              <0x0 0x1fa11000 0x0 0x160>;
        interrupts = <GIC_SPI 51 IRQ_TYPE_LEVEL_HIGH>;
        #address-cells = <1>;
        #size-cells = <0>;

        flash@0 {
          compatible = "spi-nand";
          reg = <0>;
          spi-max-frequency = <50000000>;
          spi-tx-bus-width = <1>;
          spi-rx-bus-width = <2>;
        };
      };
    };
```
